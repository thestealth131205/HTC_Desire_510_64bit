/* Copyright (c) 2013, The Linux Foundation. All rights reserved.
 *
 * This program is free software; you can redistribute it and/or modify
 * it under the terms of the GNU General Public License version 2 and
 * only version 2 as published by the Free Software Foundation.
 *
 * This program is distributed in the hope that it will be useful,
 * but WITHOUT ANY WARRANTY; without even the implied warranty of
 * MERCHANTABILITY or FITNESS FOR A PARTICULAR PURPOSE.  See the
 * GNU General Public License for more details.
 */

qcom,a11-8x16-unknown-batterydata {
	qcom,fcc-mah = <2100>;
	qcom,default-rbatt-mohm = <210>;
	qcom,rbatt-capacitive-mohm = <50>;
	qcom,flat-ocv-threshold-uv = <3800000>;
	qcom,max-voltage-uv = <4200000>;
	qcom,v-cutoff-uv = <3400000>;
	qcom,batt-id-kohm = <99>;
	qcom,battery-type = "a11-8x16-unknown_2100mah";
	htc,capacity = <2100>;
	htc,batt_id = <255>;
	htc,id_raw_min = <(-1)>;
	htc,id_raw_max = <(-1)>;
	htc,type = <0>;
	htc,model_name = "UNKNOWN";

	qcom,fcc-temp-lut {
		qcom,lut-col-legend = <(-20) (-10) 0 10 20 30 40>;
		qcom,lut-data = <1820 1980 2000 2010 2020 2025 2050>;
	};

	qcom,pc-temp-ocv-lut {
		qcom,lut-col-legend = <(-20) (-10) 0 10 20 30 40>;
		qcom,lut-row-legend = <100 95 90 85 80 75 70 65 60 55 50 45 40 35 30 25 20 15 10 9 8 7 6 5 4 3 2 1 0>;
		qcom,lut-data = <4336 4336 4335 4334 4330 4328 4325>,
				<4255 4271 4271 4270 4268 4267 4266>,
				<4186 4214 4213 4213 4211 4211 4210>,
				<4129 4160 4159 4159 4157 4156 4155>,
				<4079 4109 4108 4107 4105 4103 4104>,
				<4011 4062 4061 4060 4058 4055 4055>,
				<3966 4010 4010 4010 4010 4008 4009>,
				<3928 3958 3960 3963 3963 3962 3964>,
				<3891 3909 3909 3909 3910 3906 3910>,
				<3861 3871 3871 3870 3871 3869 3872>,
				<3838 3844 3843 3843 3844 3842 3844>,
				<3822 3821 3821 3821 3821 3819 3821>,
				<3809 3801 3801 3802 3800 3797 3798>,
				<3794 3784 3784 3783 3775 3769 3767>,
				<3779 3765 3759 3754 3744 3735 3735>,
				<3762 3725 3717 3709 3700 3693 3692>,
				<3745 3701 3698 3694 3687 3683 3679>,
				<3723 3683 3672 3661 3650 3634 3639>,
				<3692 3596 3578 3559 3548 3548 3537>,
				<3681 3565 3548 3530 3521 3521 3511>,
				<3670 3534 3518 3502 3493 3493 3485>,
				<3659 3503 3488 3473 3466 3466 3459>,
				<3648 3471 3458 3444 3439 3439 3433>,
				<3638 3440 3428 3415 3411 3411 3407>,
				<3619 3400 3376 3352 3346 3346 3340>,
				<3600 3361 3324 3288 3280 3280 3273>,
				<3581 3321 3273 3224 3215 3215 3206>,
				<3562 3281 3221 3160 3150 3150 3139>,
				<3544 3242 3169 3097 3084 3084 3072>;
	};

	qcom,rbatt-sf-lut {
		qcom,lut-col-legend = <(-20) (-10) 0 10 20 30 40>;
		qcom,lut-row-legend = <100 95 90 85 80 75 70 65 60 55 50 45 40 35 30 25 20 15 10>;
		qcom,lut-data = <1770 621 309 173 124 102 95>,
						<1456 609 304 175 124 104 95>,
						<1426 604 302 174 123 104 95>,
						<1408 605 301 175 125 104 94>,
						<1394 605 299 172 125 104 94>,
						<1381 602 300 173 127 106 96>,
						<1389 600 303 174 126 105 96>,
						<1392 609 307 177 128 106 97>,
						<1401 609 313 180 129 107 96>,
						<1405 613 314 181 131 108 97>,
						<1408 616 324 184 131 109 97>,
						<1406 626 329 187 134 109 98>,
						<1415 634 338 192 136 110 99>,
						<1438 645 350 201 140 111 99>,
						<1437 660 361 208 142 113 101>,
						<1435 670 376 215 145 116 101>,
						<1434 675 386 227 152 117 103>,
						<1446 680 399 238 157 120 104>,
						<1463 702 412 247 164 124 108>;
	};
};
